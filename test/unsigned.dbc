VERSION ""
NS_ :

BS_:
BU_: Sender Receiver

BO_ 256 UnsignedStatus: 2 Sender
 SG_ Speed : 0|8@1+ (1,0) [0|255] "rpm" Receiver
 SG_ Temperature : 8|8@1+ (1,-40) [-40|215] "degC" Receiver

BO_ 258 Unranged: 1 Sender
 SG_ Raw : 0|8@1+ (1,0) [0|0] "" Receiver

BO_ 259 Clash: 1 Sender
 SG_ Sig_X : 0|8@1+ (1,0) [0|10] "" Receiver

BO_ 260 Clash_Sig: 1 Sender
 SG_ X : 0|8@1+ (1,0) [0|20] "" Receiver

BO_ 261 Vt: 1 Sender
 SG_ Vt : 0|8@1+ (1,0) [1|2] "" Receiver

BO_ 262 VER: 1 Sender
 SG_ UNSIGNED : 0|8@1+ (1,0) [3|9] "" Receiver

BO_ 257 Empty: 0 Sender

VAL_ 261 Vt 0 "MIN" 3 "MAX" ;
